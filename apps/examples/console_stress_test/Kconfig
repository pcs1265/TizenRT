## lib/libxx/Kconfig
```kconfig
#
# For a description of the syntax of this configuration file,
# see kconfig-language at https://www.kernel.org/doc/Documentation/kbuild/kconfig-language.txt
#

comment "Basic CXX Support"

config C99_BOOL8
	bool "sizeof(_Bool) is 8-bits"
	default n
	---help---
		This setting means (1) your C++ compiler has sizeof(_Bool) == 8, (2)
		your C compiler supports the C99 _Bool intrinsic type, and (2) that
		the C99 _Bool type also has size 1.

config HAVE_CXX
	bool "Have C++ compiler"
	default n
	---help---
		Toolchain supports C++ and CXX, CXXFLAGS, and COMPILEXX have been
		defined in the configurations Make.defs file.

if HAVE_CXX


choice CXX_VERSION
	prompt "c++version"
	default CXX_VERSION_11

config CXX_VERSION_11
	bool "c++11"

config CXX_VERSION_14
	bool "c++14"

config CXX_VERSION_17
	bool "c++17"

endchoice


config CXX_NEWLONG
	bool "size_t is type long"
	default n
	---help---
		size_t may be type long or type int.  This matters for some
		C++ library routines because the TinyAra size_t might not have
		the same underlying type as your toolchain's size_t.

choice
	prompt "C++ Library"
	default LIBCXX

config LIBCXXTOOLCHAIN
	bool "Toolchain C++ support"
	select HAVE_CXXINITIALIZE if BUILD_FLAT
	select BINFMT_CONSTRUCTORS if APP_BINARY_SEPARATION
	select LIBC_LOCALE
	---help---
		Use Standard C++ library from toolchain.

#config LIBCXXMINI
#	bool "Basic C++ support"
#	---help---
#		A fragmentary C++ library that will allow to build only
#		the simplest of C++ applications. Only contain basic C++
#		runtime support function.

config LIBCXX
	bool "LLVM libc++ C++ Standard Library"
	select HAVE_CXXINITIALIZE if BUILD_FLAT
	select BINFMT_CONSTRUCTORS if APP_BINARY_SEPARATION
	---help---
		LLVM "libc++" C++ Standard Library
		https://libcxx.llvm.org/

endchoice

config CXX_EXCEPTION
	bool "Enable Exception Suppport"
	default y
	---help---
		Enable exception support in C++.

		NOTE: C++ exception support requires toolchain version 10.3.1. If you
		are enabling C++ exception then use docker image version 2.0.0. Use
		menuconfig (Build Setup -> Docker Image Version) to set CONFIG_DOCKER_VERSION=2.0.0

config CXX_RTTI
	bool "Enable RTTI Support"

config CXX_WCHAR
	bool "Enable Wide Character Support"

config CXX_LOCALIZATION
	bool "Enable Locale and Stream Support"
	depends on LIBC_LOCALE

config CXX_HAVE_LIBSUPCXX
	bool "Have libsupc++ (required)"
	default y
	---help---
		Select if your toolchain provides libsupc++.  This option is required
		at present because the built-in libsupc++ support is incomplete.

endif
```

## os/arch/arm/src/qemu-virt/virtio/Kconfig
```kconfig
# QEMU Virtio support
#

config QEMU_VIRT_VIRTIO
	bool "Virtio support for QEMU Virt machine"
	default y
	help
	  Enable Virtio support for QEMU Virt machine.
	  This enables the generic virtio-mmio framework and
	  device drivers for virtio devices.

if QEMU_VIRT_VIRTIO

config QEMU_VIRT_VIRTIO_BLK
	bool "Virtio block device support"
	default y
	help
	  Enable Virtio block device support.
	  This enables the virtio-blk driver for block devices
	  connected via virtio-mmio transport.

config QEMU_VIRT_VIRTIO_BLK_MTD
	bool "Virtio block to MTD translation layer"
	default n
	depends on QEMU_VIRT_VIRTIO_BLK && FLASH_PARTITION
	help
	  Enable an MTD translation layer backed by the QEMU virtio-blk
	  device. This lets the existing flash partition code create
	  /dev/mtdblockX devices from qemu_blk.bin instead of pflash.

config QEMU_VIRT_VIRTIO_NET
	bool "Virtio network device support"
	default y if NET_NETMGR
	depends on NET && NET_NETMGR && !NET_NETMGR_ZEROCOPY
	select SCHED_HPWORK
	help
	  Enable virtio-net support for the QEMU virt machine. The driver
	  registers an Ethernet NIC with netmgr and uses QEMU's virtio-mmio
	  transport.

config QEMU_VIRT_VIRTIO_NET_DEVICE_NUM
	int "Virtio network MMIO device number"
	default 1 if QEMU_VIRT_VIRTIO_BLK
	default 0
	depends on QEMU_VIRT_VIRTIO_NET
	help
	  The virtio-mmio bus slot used by virtio-net. If virtio-blk is also
	  enabled, slot 0 is usually occupied by the block device, so the
	  network device defaults to slot 1.

config QEMU_VIRT_VIRTIO_NET_RX_BUFS
	int "Virtio network RX buffers"
	default 16
	range 2 64
	depends on QEMU_VIRT_VIRTIO_NET
	help
	  Number of receive buffers posted to the virtio-net RX queue.

endif # QEMU_VIRT_VIRTIO
```

## os/board/qemu-virt/Kconfig
```kconfig
#
# For a description of the syntax of this configuration file,
# see kconfig-language at https://www.kernel.org/doc/Documentation/kbuild/kconfig-language.txt
#

if ARCH_BOARD_QEMU_VIRT

config FLASH_VSTART
    hex
    default 0x00000000
    help
        A start virtual address of flash (in hex).
        This is fixed value, so user doesn't need to change it.
        Keep this value same as FLASH_START_ADDR.

config FLASH_START_ADDR
    hex
    default 0x00000000
    help
        A start address of flash (in hex).
        This is fixed value, so user doesn't need to change it.

config FLASH_SIZE
    int
    default 67108864
    help
        A size of flash (in bytes).
        This is fixed value, so user doesn't need to change it.
endif #ARCH_BOARD_QEMU_VIRT

config USERFS_MNTPT
    string
    default "/mnt" if AUTOMOUNT_USERFS
    help
        A mount point name of first flash partition.
```

## os/drivers/virtio/Kconfig
```kconfig
# QEMU Virtio support
#

config QEMU_VIRT_VIRTIO
	bool "Virtio support for QEMU Virt machine"
	default y
	help
	  Enable Virtio support for QEMU Virt machine.
	  This enables the generic virtio-mmio framework and
	  device drivers for virtio devices.

if QEMU_VIRT_VIRTIO

config QEMU_VIRT_VIRTIO_BLK
	bool "Virtio block device support"
	default y
	help
	  Enable Virtio block device support.
	  This enables the virtio-blk driver for block devices
	  connected via virtio-mmio transport.

config QEMU_VIRT_VIRTIO_BLK_MTD
	bool "Virtio block to MTD translation layer"
	default n
	depends on QEMU_VIRT_VIRTIO_BLK && FLASH_PARTITION
	help
	  Enable an MTD translation layer backed by the QEMU virtio-blk
	  device. This lets the existing flash partition code create
	  /dev/mtdblockX devices from qemu_blk.bin instead of pflash.

endif # QEMU_VIRT_VIRTIO
```
